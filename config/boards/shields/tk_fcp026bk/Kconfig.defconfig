## config/boards/shields/tk_fcp026bk/Kconfig.defconfig
```kconfig
if SHIELD_TK_FCP026BK

config ZMK_KEYBOARD_NAME
    default "TK-FCP026BK"

config ZMK_USB
    default y

config ZMK_BLE
    default y

# I2C（MCP23017接続用）
config I2C
    default y

# GPIO expander（MCP23017）
config GPIO
    default y

config MCP230XX
    default y

endif
```
